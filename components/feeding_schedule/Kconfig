## components/feeding_schedule/Kconfig
```kconfig
menu "Feeding Schedule"

    config FEEDING_SCHEDULE_MAX_FEEDS
        int "Maximum number of feeding times"
        range 1 16
        default 4
        help
            Maximum number of scheduled feeding times the
            schedule can hold.

endmenu
```

## sdkconfig.defaults
```kconfig
# Target
CONFIG_IDF_TARGET="esp32s3"

# Custom partition table
CONFIG_PARTITION_TABLE_CUSTOM=y
CONFIG_PARTITION_TABLE_CUSTOM_FILENAME="partitions.csv"

# Board has 16 MB flash
CONFIG_ESPTOOLPY_FLASHSIZE_16MB=y

# Console over native USB
CONFIG_ESP_CONSOLE_USB_SERIAL_JTAG=y

# Bluetooth + NimBLE
CONFIG_BT_ENABLED=y
CONFIG_BT_NIMBLE_ENABLED=y
```
