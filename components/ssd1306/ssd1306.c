#include "ssd1306.h"
#include <string.h>
#include "freertos/FreeRTOS.h"
#include "freertos/task.h"

#define SSD1306_I2C_HZ          400000
#define SSD1306_CMD_TIMEOUT_MS  1000

#define FONT_W 8
#define FONT_FIRST 0x20
#define FONT_COUNT (sizeof(ssd1306_font8x16) / 16)

/* Standard ASCII 8x16 font */
static const uint8_t ssd1306_font8x16 [] = {
    0x00,0x00,0x00,0x00,0x00,0x00,0x00,0x00,0x00,0x00,0x00,0x00,0x00,0x00,0x00,0x00, //   0
    0x00,0x00,0x00,0xF8,0x00,0x00,0x00,0x00,0x00,0x00,0x00,0x33,0x30,0x00,0x00,0x00, // ! 1
    0x00,0x10,0x0C,0x06,0x10,0x0C,0x06,0x00,0x00,0x00,0x00,0x00,0x00,0x00,0x00,0x00, // " 2
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    0x00,0x06,0x01,0x01,0x02,0x02,0x04,0x04,0x00,0x00,0x00,0x00,0x00,0x00,0x00,0x00, // ~ 94
};

static esp_err_t ssd1306_cmd(ssd1306_t *d, uint8_t cmd)
{
    uint8_t buf[2] = {0x00, cmd};
    return i2c_master_transmit(d->dev, buf, sizeof(buf), SSD1306_CMD_TIMEOUT_MS);
}

static esp_err_t ssd1306_data(ssd1306_t *d, const uint8_t *data, size_t len)
{
    uint8_t ctrl = 0x40;
    i2c_master_transmit_multi_buffer_info_t buffers[2] = {
        {
            .write_buffer = &ctrl,
            .buffer_size = 1
        },
        {
            .write_buffer = (uint8_t *)data,
            .buffer_size = len
        },
    };
    return i2c_master_multi_buffer_transmit(d->dev, buffers, 2, SSD1306_CMD_TIMEOUT_MS);
}

esp_err_t ssd1306_init(ssd1306_t *d, i2c_master_bus_handle_t bus, uint8_t addr)
{
    i2c_device_config_t dev_cfg = {
        .dev_addr_length = I2C_ADDR_BIT_LEN_7,
        .device_address = addr,
        .scl_speed_hz = SSD1306_I2C_HZ,
    };
    esp_err_t err = i2c_master_bus_add_device(bus, &dev_cfg, &d->dev);
    if (err != ESP_OK) return err;

    vTaskDelay(pdMS_TO_TICKS(100));

    // init seq for 128x64 SSD1306
    static const uint8_t init_seq[] = {
        0xAE,             // display off
        0xD5, 0x80,       // clock divide / osc freq
        0xA8, 0x3F,       // multiplex ratio = 64
        0xD3, 0x00,       // display offset = 0
        0x40,             // start line = 0
        0x8D, 0x14,       // charge pump on
        0x20, 0x00,       // horizontal addressing mode
        0xA1,             // segment remap
        0xC8,             // COM scan direction reversed
        0xDA, 0x12,       // COM pins config
        0x81, 0x8F,       // contrast
        0xD9, 0x1F,       // pre-charge period
        0xDB, 0x40,       // VCOMH deselect level
        0xA4,             // resume display from RAM
        0xA6,             // normal (non-inverted)
    };
    for (size_t i = 0; i < sizeof(init_seq); i++)
    {
        err = ssd1306_cmd(d, init_seq[i]);
        if (err != ESP_OK) return err;
    }

    ssd1306_clear(d);
    err = ssd1306_flush(d);
    if (err != ESP_OK) return err;

    err = ssd1306_cmd(d, 0xAF);   // display on
    if (err != ESP_OK) return err;

    vTaskDelay(pdMS_TO_TICKS(100));
    return ESP_OK;
}

void ssd1306_clear(ssd1306_t *d)
{
    memset(d->buffer, 0x00, sizeof(d->buffer));
}

void ssd1306_draw_text(ssd1306_t *d, uint8_t x, uint8_t y, const char *str)
{
    int page = y / 8;
    if (page + 1 >= SSD1306_PAGES) return;

    int top_base = page * SSD1306_WIDTH;
    int bot_base = top_base + SSD1306_WIDTH;

    while (*str && x + FONT_W <= SSD1306_WIDTH)
    {
        unsigned char c = (unsigned char)*str++;
        if (c < FONT_FIRST || c >= FONT_FIRST + FONT_COUNT) c = ' ';
        const uint8_t *g = &ssd1306_font8x16[(c - FONT_FIRST) * 16];

        for (int i = 0; i < FONT_W; i++)
        {
            d->buffer[top_base + x + i] = g[i];
            d->buffer[bot_base + x + i] = g[i + 8];
        }
        x += FONT_W;
    }
}

esp_err_t ssd1306_flush(ssd1306_t *d)
{
    const uint8_t window[] = {
        0x21, 0x00, SSD1306_WIDTH - 1,   // column address range
        0x22, 0x00, SSD1306_PAGES - 1,   // page address range
    };
    for (size_t i = 0; i < sizeof(window); i++)
    {
        esp_err_t err = ssd1306_cmd(d, window[i]);
        if (err != ESP_OK) return err;
    }

    return ssd1306_data(d, d->buffer, sizeof(d->buffer));
}